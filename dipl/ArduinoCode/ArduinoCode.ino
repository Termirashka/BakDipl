#include <Wire.h> // подключение библиотеки, используется для связи микроконтроллера с устройствами и модулями через интерфейс I2C 
#include "DHT.h" // подключение библиотеки, предназначена для работы с датчиками температуры и влажности DHT 22
#include <iarduino_RTC.h> // подключение библиотеки, позволяет читать и записывать время RTC модулей на базе чипов DS1302
#include <LiquidCrystal_I2C.h> // подключение библиотеки, предназначена для работы по 8-битному (4-битному) параллельному интерфейс, для дисплея, подключенного по шине I2C

LiquidCrystal_I2C _lcd1(0x20, 16, 2); // адрес дисплея, количество символов в строке, количество строк
int analogYL38 = PC3;
int analog = PC2;// A3 - контакт, к которому подключен YL-38
//создаём переменную для хранения значения влажности
#define DHTPIN PD4
#define DHTTYPE DHT11
int t, h, val2, z, val, i;

DHT dht1(DHTPIN, DHTTYPE); // переопределение названия датчика
iarduino_RTC RTC1(RTC_DS1302, 11, 9, 10);

String _RTC1_GetTime1_StrOut;
void setup()
{
  pinMode(12, OUTPUT); // настраиваем контакт №12 на выход красного светодиода
  pinMode(analogYL38, INPUT);
  Wire.begin(); // инициализирует библиотеку Wire и подключается к шине I2C
  dht1.begin();// инициализация ЖКИ
  delay(10); // задержка 10 мс
  _lcd1.init(); // инициализация ЖКИ
   _lcd1.clear(); // очистка дисплея
  _lcd1.setCursor(0, 0); // установка курсора на первую строку первый ряд для вывода информации
  _lcd1.print("Starting");
  RTC1.begin(); // инициализация RTC
 // RTC1.period(1); // устанавливает минимальный период обращения к модулю (в минутах)
  _lcd1.backlight(); //включение подсветки ЖКИ

 
}

void loop()
{
 h = dht1.readHumidity();
 t = dht1.readTemperature();// чтение данных с датчика DHT22
  if (t < 20) { digitalWrite(PD2, HIGH); // включение подогрева 
      }
  else { digitalWrite(PD2, LOW); }
  
  _lcd1.clear(); // очистка дисплея
  _lcd1.setCursor(0, 0); // установка курсора на первую строку первый ряд для вывода информации
  _lcd1.print("temp:");
  _lcd1.print(t);// вывод "temp" и значения температуры с датчика DHT22 через функцию, определяющую, с какой точностью будут выведены показания
  _lcd1.setCursor(0, 1); // установка курсора на вторую строку первый ряд для вывода информации
  _lcd1.print("vlazhn v:");
  _lcd1.print(h); // вывод "vlazhn v" и значения влажности с датчика DHT22 через функцию, определяющую, с какой точностью будут выведены показания
 
  delay(1000); // задержка 2 с
  _lcd1.clear(); // очистка дисплея
  _lcd1.setCursor(0, 0); // установка курсора на первую строку первый ряд для вывода информации
  _RTC1_GetTime1_StrOut = RTC1.gettime("H:i:s, D");// запрос данных с RTC
  _lcd1.print(_RTC1_GetTime1_StrOut);  // вывод на ЖКИ времени в формате "чч:мм:сс" и дня недели в сокращенном формате, состоящего из трех букв
  _lcd1.setCursor(0, 1); // установка курсора на вторую строку первый ряд для вывода информации
  _RTC1_GetTime1_StrOut = RTC1.gettime("d-m-Y"); // запрос данных с RTC
  _lcd1.print(_RTC1_GetTime1_StrOut);// вывод на ЖКИ даты в формате "дд-мм-гггг"
  
   val2 = analogRead(analog);
  delay(1000); // задержка 2 с
  _lcd1.clear(); // очистка дисплея
  _lcd1.setCursor(0, 0); // установка курсора на первую строку первый ряд для вывода информации
  _lcd1.print("urov vl:" );// вывод "Soil M:"
   z = 100 - val2 / 10.24; // вычисление значения влажности
  _lcd1.print(z );// вывод значения влажности почвы с датчика YL-38
  
  delay(1000);
  if (val2 < 905) // если значение, считанное с датчика YL-38, меньше 30%
  { val = analogRead(analogYL38);//создаём переменную для хранения значения влажности // Считываем значение с контакта A3
_lcd1.clear(); // очистка дисплея
  _lcd1.setCursor(0, 0); // установка курсора на первую строку первый ряд для вывода информации
   _lcd1.print("Soil M:"); // вывод "Opasniy uroven"
    z = 100 - val / 10.24; // вычисление значения влажности
    _lcd1.print(z); // вывод "Opasniy uroven"
    
    if (val > 705) // если значение, считанное с датчика YL-38, меньше 30%
    {
      _lcd1.setCursor(0, 1); // установка курсора на вторую строку первый ряд для вывода информации
      _lcd1.print("nizkaya , ON"); // вывод "Opasniy uroven"
      for ( i = 0; i < 5; i++ ) // цикл для проигрывания мелодии
      {
        digitalWrite(12, HIGH); // установка высокого уровня напряжения на выводе 12 - светодиод
        delay( 500 ); // задержка 500 мс
        digitalWrite(12, LOW); // установка низкого уровня напряжения на выводе 12 - светодиод
        delay( 500 ); // задержка 500 мс
      }
    }
    else {
      _lcd1.setCursor(0, 1); // установка курсора на вторую строку первый ряд для вывода информации
      _lcd1.print("norm , OFF"); // вывод "Opasniy uroven"
      for ( i = 0; i < 5; i++ ) // цикл для проигрывания мелодии
      {
        digitalWrite(12, HIGH); // установка высокого уровня напряжения на выводе 12 - светодиод
        delay( 500 ); // задержка 500 мс
        digitalWrite(12, LOW); // установка низкого уровня напряжения на выводе 12 - светодиод
        delay( 500 ); // задержка 500 мс
      }
    }
  }
 else {
      _lcd1.setCursor(0, 1); // установка курсора на вторую строку первый ряд для вывода информации
      _lcd1.print("vodichki"); // вывод "Opasniy uroven"
      for ( i = 0; i < 5; i++ ) // цикл для проигрывания мелодии
      {
        digitalWrite(12, HIGH); // установка высокого уровня напряжения на выводе 12 - светодиод
        delay( 1500 ); // задержка 500 мс
        digitalWrite(12, LOW); // установка низкого уровня напряжения на выводе 12 - светодиод
        delay( 1500 ); // задержка 500 мс
      }
    }
}
